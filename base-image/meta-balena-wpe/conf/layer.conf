## base-image/meta-balena-wpe/conf/layer.conf
```bitbake
BBPATH .= ":${LAYERDIR}"

BBFILES += "${LAYERDIR}/recipes-*/*/*.bb \
            ${LAYERDIR}/recipes-*/*/*.bbappend"

BBFILE_COLLECTIONS += "balena-wpe"
BBFILE_PATTERN_balena-wpe := "^${LAYERDIR}/"
BBFILE_PRIORITY_balena-wpe = "99"

LAYERSERIES_COMPAT_balena-wpe = "sumo thud warrior dunfell"
```

## base-image/meta-resin-wpe/conf/layer.conf
```bitbake
BBPATH .= ":${LAYERDIR}"

BBFILES += "${LAYERDIR}/recipes-*/*/*.bb \
            ${LAYERDIR}/recipes-*/*/*.bbappend"

BBFILE_COLLECTIONS += "resin-wpe"
BBFILE_PATTERN_resin-wpe := "^${LAYERDIR}/"
BBFILE_PRIORITY_resin-wpe = "99"
```
